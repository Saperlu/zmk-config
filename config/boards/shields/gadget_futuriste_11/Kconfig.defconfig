## config/boards/shields/gadget_futuriste_11/Kconfig.defconfig
```kconfig
# Copyright (c) 2020 The ZMK Contributors
# SPDX-License-Identifier: MIT

config ZMK_BLE
	default y

config ZMK_USB
	default y
```

## config/boards/shields/gadget_futuriste_11/Kconfig.shield
```kconfig
# Copyright (c) 2020 The ZMK Contributors
# SPDX-License-Identifier: MIT

config SHIELD_GADGET_FUTURISTE_11
	def_bool $(shields_list_contains,gadget_futuriste_11)
```
